## config/boards/shields/tp45/Kconfig.shield
```kconfig
# Copyright (c) 2020 Pete Johanson
# SPDX-License-Identifier: MIT

config SHIELD_tp45_LEFT
    def_bool $(shields_list_contains,tp45_left)

config SHIELD_tp45_RIGHT
    def_bool $(shields_list_contains,tp45_right)
```

## config/west.yml
```yaml
manifest:
  remotes:
    # zmk official
    - name: zmkfirmware
      url-base: https://github.com/zmkfirmware
    - name: qi4373
      url-base: https://github.com/qi4373
  projects:
    - name: zmk
      remote: zmkfirmware
      revision: main
      # remote: qi4373
      # revision: encoder-fix
      import: app/west.yml
  self:
    path: config
```
